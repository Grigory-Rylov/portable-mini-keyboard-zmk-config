## config/boards/shields/pordable_pad/Kconfig.defconfig
```kconfig
if SHIELD_PORTABLE_PAD

    config ZMK_KEYBOARD_NAME
        default "OSIK portable pad"

    config ZMK_SPLIT_BLE_ROLE_CENTRAL
        default y
endif

if SHIELD_PORTABLE_PAD

    config ZMK_SPLIT
        default y

endif
```
